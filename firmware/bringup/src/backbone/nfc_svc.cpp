#include "nfc_svc.h"

#include <Arduino.h>
#include <SPI.h>
#include <rfal_nfc.h>
#include <rfal_nfca.h>
#include <rfal_rfst25r200.h>
#include <string.h>

#ifndef BACKBONE_SAFE_RECOVERY
#define BACKBONE_SAFE_RECOVERY 0
#endif

static const int kNfcSck = 10;
static const int kNfcMosi = 18;
static const int kNfcMiso = 19;
static const int kNfcCs = 6;
static const int kNfcIrq = 5;
static const int kNfcReset = 7;

static RfalRfST25R200Class s_rf(&SPI, kNfcCs, kNfcIrq, kNfcReset, 5000000);
static RfalNfcClass s_nfc(&s_rf);
static bool s_ready = false;
static uint8_t s_ic_id = 0;
static uint8_t s_error = 0;
static uint8_t s_scan_stage = 0;
static uint8_t s_scan_antenna = 0;
static uint8_t s_antenna = 0;
static uint8_t s_tag_type = 0;
static uint8_t s_uid[10] = {0};
static uint8_t s_uid_len = 0;
static bool s_tag_present = false;
static volatile bool s_irq_pending = false;
static volatile bool s_wakeup_enabled = false;
static volatile uint16_t s_wakeup_irq_count = 0;
static uint8_t s_wakeup_antenna = 1;
static bool s_probe_ok = false;
static bool s_rfal_tried = false;
static bool s_wakeup_tried = false;

static void nfc_irq_callback() {
    // The driver has already latched the ST25R100 IRQ status. Keep the upper
    // callback ISR-safe: all RFAL state-machine and SPI work stays in loop().
    s_irq_pending = true;
    if (s_wakeup_enabled) {
        s_wakeup_irq_count = (uint16_t)(s_wakeup_irq_count + 1U);
    }
}

static void nfc_hold_reset() {
    pinMode(kNfcReset, OUTPUT);
    digitalWrite(kNfcReset, HIGH);  // ST25R100 reset is active-high
    pinMode(kNfcIrq, INPUT_PULLDOWN);
}

static void nfc_quarantine() {
    detachInterrupt(digitalPinToInterrupt(kNfcIrq));
    nfc_hold_reset();
    s_ready = false;
    s_wakeup_enabled = false;
    s_irq_pending = false;
}

static uint8_t nfc_spi_read_ic_id() {
    pinMode(kNfcCs, OUTPUT);
    digitalWrite(kNfcCs, HIGH);
    SPI.beginTransaction(SPISettings(1000000, MSBFIRST, SPI_MODE1));
    digitalWrite(kNfcCs, LOW);
    SPI.transfer((uint8_t)(0x3F | 0x80));  // IC_ID | READ
    const uint8_t id = SPI.transfer(0);
    digitalWrite(kNfcCs, HIGH);
    SPI.endTransaction();
    return id;
}

static bool nfc_irq_stuck_high() {
    if (digitalRead(kNfcIrq) != HIGH) {
        return false;
    }
    // OSC-ready and other latched IRQs hold the pin high. Reading IRQ1..3
    // clears them on a working ST25R100. Only treat as stuck if it stays high.
    SPI.beginTransaction(SPISettings(1000000, MSBFIRST, SPI_MODE1));
    digitalWrite(kNfcCs, LOW);
    SPI.transfer((uint8_t)(0x3C | 0x80));  // IRQ1 | READ, auto-increment
    (void)SPI.transfer(0);
    (void)SPI.transfer(0);
    (void)SPI.transfer(0);
    digitalWrite(kNfcCs, HIGH);
    SPI.endTransaction();
    delay(1);
    return digitalRead(kNfcIrq) == HIGH;
}

static ReturnCode apply_antenna(uint8_t antenna);

static void stop_wakeup() {
    if (!s_ready) {
        s_wakeup_enabled = false;
        s_irq_pending = false;
        return;
    }
    if (s_wakeup_enabled && s_rf.rfalWakeUpModeIsEnabled()) {
        s_rf.rfalWakeUpModeStop();
    }
    s_wakeup_enabled = false;
    s_irq_pending = false;
}

static bool start_wakeup(uint8_t antenna) {
    stop_wakeup();
    s_rf.rfalFieldOff();
#if BACKBONE_SAFE_RECOVERY
    // Recovery mode must remain polling-only even after an explicit NFC
    // command. Re-enabling LPCD here made the following TWAI command hang
    // intermittently when the ST25R IRQ line asserted.
    s_wakeup_antenna = antenna;
    s_wakeup_enabled = false;
    s_irq_pending = false;
    return true;
#endif
    // PCB routing is crossed by design: physical ANT1 uses RFO2/RFI2 and
    // physical ANT2 uses RFO1/RFI1.
    if (apply_antenna(antenna) != ERR_NONE) {
        s_error = ERR_IO;
        return false;
    }

    rfalWakeUpConfig cfg = {};
    cfg.period = RFAL_WUM_PERIOD_215MS;
    // The timer IRQ is used only to alternate the two physical antennas.
    // Actual tag detection is generated by the inductive I/Q thresholds.
    cfg.irqTout = true;
    cfg.swTagDetect = false;
    cfg.autoAvg = true;
    cfg.skipCal = false;
    cfg.skipReCal = false;
    cfg.delCal = true;
    cfg.delRef = true;
    cfg.measDur = RFAL_WUM_MEAS_DUR_44_28;
    cfg.measFil = RFAL_WUM_MEAS_FIL_SLOW;

    cfg.indAmp.enabled = true;
    cfg.indAmp.delta = 4;
    cfg.indAmp.reference = RFAL_WUM_REFERENCE_AUTO;
    cfg.indAmp.threshold = RFAL_WUM_TRE_ABOVE | RFAL_WUM_TRE_BELOW;
    cfg.indAmp.autoAvg = true;
    cfg.indAmp.aaInclMeas = true;
    cfg.indAmp.aaWeight = RFAL_WUM_AA_WEIGHT_32;

    cfg.cap.enabled = true;
    cfg.cap.delta = 4;
    cfg.cap.reference = RFAL_WUM_REFERENCE_AUTO;
    cfg.cap.threshold = RFAL_WUM_TRE_ABOVE | RFAL_WUM_TRE_BELOW;
    cfg.cap.autoAvg = true;
    cfg.cap.aaInclMeas = true;
    cfg.cap.aaWeight = RFAL_WUM_AA_WEIGHT_32;

    const ReturnCode rc = s_rf.rfalWakeUpModeStart(&cfg);
    s_wakeup_enabled = rc == ERR_NONE;
    if (!s_wakeup_enabled) s_error = (uint8_t)rc;
    s_wakeup_antenna = antenna;
    s_irq_pending = false;
    return s_wakeup_enabled;
}

// Datasheet GENERAL: single=1 + rfo2 selects the RFO/RFI pair together
// (0 = RFO1/RFI1, 1 = RFO2/RFI2). Default after SET_DEFAULT is differential
// (single=0): both RFO drivers on, RX combines RFI1+RFI2 → TX on ANT1, RX deaf.
// KiCad ANT1 matching is RFO2_C7_ANT / RFI2_C7_ANT; ANT2 is RFO1.
static ReturnCode apply_antenna(uint8_t antenna) {
    const bool rfo2 = (antenna == 1);
    ReturnCode rc = s_rf.st25r200SetAntennaMode(true, rfo2);
    if (rc != ERR_NONE) return rc;
    uint8_t general = 0;
    rc = s_rf.st25r200ReadRegister(ST25R200_REG_GENERAL, &general);
    if (rc != ERR_NONE) return rc;
    const uint8_t expect = ST25R200_REG_GENERAL_single | (rfo2 ? ST25R200_REG_GENERAL_rfo2 : 0);
    if ((general & (ST25R200_REG_GENERAL_single | ST25R200_REG_GENERAL_rfo2)) != expect) {
        rc = s_rf.st25r200ChangeRegisterBits(ST25R200_REG_GENERAL,
                                             ST25R200_REG_GENERAL_single | ST25R200_REG_GENERAL_rfo2,
                                             expect);
    }
    return rc;
}

static void apply_rx_gain() {
    s_rf.st25r200ChangeRegisterBits(ST25R200_REG_RX_ANA2,
                                    ST25R200_REG_RX_ANA2_afe_gain_rw_mask,
                                    (uint8_t)(0x0FU << ST25R200_REG_RX_ANA2_afe_gain_rw_shift));
}

static ReturnCode prepare_poll_antenna(uint8_t antenna) {
    s_rf.rfalFieldOff();
    s_rf.rfalSetGT(rfalConvMsTo1fc(15U));
    ReturnCode rc = s_nfc.rfalNfcaPollerInitialize();
    if (rc == ERR_NONE) rc = apply_antenna(antenna);
    if (rc == ERR_NONE) rc = s_rf.rfalFieldOnAndStartGT();
    if (rc == ERR_NONE) rc = apply_antenna(antenna);
    if (rc == ERR_NONE) apply_rx_gain();
    if (rc == ERR_NONE) delay(40);
    return rc;
}

static ReturnCode wait_transceive(uint32_t timeout_ms) {
    const uint32_t started = millis();
    while (true) {
        s_rf.rfalWorker();
        const ReturnCode rc = s_rf.rfalGetTransceiveStatus();
        if (rc != ERR_BUSY) return rc;
        if ((uint32_t)(millis() - started) >= timeout_ms) {
            s_rf.rfalFieldOff();
            return ERR_TIMEOUT;
        }
        delay(1);
    }
}

static ReturnCode nfca_short_frame(uint8_t cmd7, rfalNfcaSensRes *sens, uint32_t fwt_ms) {
    uint8_t command = cmd7;
    uint16_t bits = 0;
    rfalTransceiveContext ctx = {};
    s_rf.st25r200SetRegisterBits(ST25R200_REG_PROTOCOL_RX1, ST25R200_REG_PROTOCOL_RX1_antcl);
    ctx.txBuf = &command;
    ctx.txBufLen = 7;
    ctx.rxBuf = reinterpret_cast<uint8_t *>(sens);
    ctx.rxBufLen = 16;
    ctx.rxRcvdLen = &bits;
    ctx.fwt = rfalConvMsTo1fc(fwt_ms);
    ctx.flags = RFAL_TXRX_FLAGS_CRC_TX_MANUAL | RFAL_TXRX_FLAGS_PAR_TX_NONE |
                RFAL_TXRX_FLAGS_CRC_RX_KEEP | RFAL_TXRX_FLAGS_CRC_RX_MANUAL;
    ReturnCode rc = s_rf.rfalStartTransceive(&ctx);
    if (rc == ERR_NONE) rc = wait_transceive(80);
    s_rf.st25r200ClrRegisterBits(ST25R200_REG_PROTOCOL_RX1, ST25R200_REG_PROTOCOL_RX1_antcl);
    if ((rc == ERR_RF_COLLISION) || (rc == ERR_CRC) || (rc == ERR_FRAMING) ||
        (rc == ERR_PAR) || (rc == ERR_INCOMPLETE_BYTE)) {
        rc = ERR_NONE;
    }
    return rc;
}

static bool select_nfca(uint8_t antenna, rfalNfcaListenDevice *device) {
    s_scan_antenna = antenna;
    s_scan_stage = 1;
    if (!s_ready || antenna < 1 || antenna > 2 || !device) {
        s_error = ERR_PARAM;
        return false;
    }
    if (prepare_poll_antenna(antenna) != ERR_NONE) {
        s_error = ERR_IO;
        s_rf.rfalFieldOff();
        return false;
    }

    rfalNfcaSensRes sens = {};
    ReturnCode rc = ERR_TIMEOUT;
    s_scan_stage = 2;
    for (uint8_t attempt = 0; attempt < 3 && rc != ERR_NONE; ++attempt) {
        memset(&sens, 0, sizeof(sens));
        if (attempt > 0) {
            s_rf.rfalFieldOnAndStartGT();
            delay(15);
        }
        rc = nfca_short_frame(RFAL_14443A_SHORTFRAME_CMD_WUPA, &sens, 5);
        if (rc != ERR_NONE) delay(8);
    }
    if (rc != ERR_NONE) {
        s_error = (uint8_t)rc;
        s_rf.rfalFieldOff();
        return false;
    }

    memset(device, 0, sizeof(*device));
    device->sensRes = sens;
    bool coll = false;
    s_scan_stage = 3;
    rc = s_nfc.rfalNfcaPollerSingleCollisionResolution(
        1, &coll, &device->selRes, device->nfcId1, &device->nfcId1Len);
    if (rc != ERR_NONE || device->nfcId1Len == 0) {
        s_error = (uint8_t)(rc == ERR_NONE ? ERR_NOTFOUND : rc);
        s_rf.rfalFieldOff();
        return false;
    }
    if (rfalNfcaIsSelResT2T(&device->selRes)) device->type = RFAL_NFCA_T2T;
    else if (rfalNfcaIsSelResT4T(&device->selRes) || rfalNfcaIsSelResT4TNFCDEP(&device->selRes))
        device->type = RFAL_NFCA_T4T;
    else device->type = RFAL_NFCA_T2T;
    s_error = 0;
    s_scan_stage = 4;
    return true;
}

static uint8_t classify(const rfalNfcaListenDevice &device) {
    if (device.type == RFAL_NFCA_T2T) return 1;
    if (device.type == RFAL_NFCA_T4T || device.type == RFAL_NFCA_T4T_NFCDEP) return 2;
    return 3;
}

static bool scan_one(uint8_t antenna, uint8_t *tag_type, uint8_t *uid, uint8_t *uid_len,
                     bool keep_selected) {
    rfalNfcaListenDevice device = {};
    if (!select_nfca(antenna, &device)) return false;
    const uint8_t type = classify(device);
    const uint8_t len = device.nfcId1Len > sizeof(s_uid) ? sizeof(s_uid) : device.nfcId1Len;
    s_antenna = antenna;
    s_tag_type = type;
    s_uid_len = len;
    memcpy(s_uid, device.nfcId1, len);
    s_tag_present = true;
    if (tag_type) *tag_type = type;
    if (uid_len) *uid_len = len;
    if (uid && len) memcpy(uid, device.nfcId1, len);
    if (!keep_selected) s_rf.rfalFieldOff();
    return true;
}

static bool nfc_ensure_rfal() {
    if (s_ready) return true;
#if BACKBONE_SAFE_RECOVERY
    // The recovery build initializes NFC only after an explicit NFC command.
    if (!s_probe_ok && !s_rfal_tried) nfc_start();
#endif
    if (s_rfal_tried || !s_probe_ok) return false;
    s_rfal_tried = true;
    if (nfc_irq_stuck_high()) {
        // RFAL ISR does while (IRQ == HIGH) { SPI read }. A stuck pin never
        // exits and the ESP32-C3 interrupt WDT resets every ~1 s.
        s_error = ERR_TIMEOUT;
        nfc_quarantine();
        return false;
    }
    const ReturnCode rc = s_nfc.rfalNfcInitialize();
    s_error = (uint8_t)rc;
    if (rc != ERR_NONE) {
        nfc_quarantine();
        return false;
    }
    s_rf.st25r200ReadRegister(0x3F, &s_ic_id);
    s_ready = (s_ic_id & 0xF8U) == 0xA8U;
    if (!s_ready) {
        s_error = ERR_HW_MISMATCH;
        nfc_quarantine();
        return false;
    }
    s_rf.rfalSetUpperLayerCallback(nfc_irq_callback);
    return true;
}

bool nfc_start() {
    s_ready = false;
    s_probe_ok = false;
    s_rfal_tried = false;
    s_wakeup_tried = false;
    s_error = 0;
    s_ic_id = 0;
    nfc_hold_reset();
    delay(2);
    SPI.begin(kNfcSck, kNfcMiso, kNfcMosi, kNfcCs);
    pinMode(kNfcCs, OUTPUT);
    digitalWrite(kNfcCs, HIGH);
    digitalWrite(kNfcReset, LOW);  // run
    delay(5);
    s_ic_id = nfc_spi_read_ic_id();
    if ((s_ic_id & 0xF8U) != 0xA8U) {
        s_error = ERR_HW_MISMATCH;
        nfc_hold_reset();
        return false;
    }
    s_probe_ok = true;
    // Full RFAL (IRQ attach) is deferred to nfc_tick / first command so a
    // missing or stuck ST25 cannot block TWAI or the LED cycle.
    return true;
}

bool nfc_ready() {
    // Do not initialize RFAL here: nfc-info used to block TWAI/USB (COBS timeout).
    return s_probe_ok && ((s_ic_id & 0xF8U) == 0xA8U);
}
void nfc_probe(uint8_t antenna, bool wupa, uint8_t result[6]) {
    memset(result, 0, 6);
    result[0] = 0xD2;
    result[2] = ERR_PARAM;
    if (antenna < 1 || antenna > 2) return;
    if (!nfc_ensure_rfal()) {
        result[2] = s_error ? s_error : ERR_IO;
        return;
    }
    stop_wakeup();
    s_rf.rfalFieldOff();
    delay(5);
    ReturnCode rc = prepare_poll_antenna(antenna);
    uint8_t rx_config = 0;
    bool restore_rx = false;
    if (rc == ERR_NONE) {
        rc = s_rf.st25r200ReadRegister(ST25R200_REG_PROTOCOL_RX1, &rx_config);
        restore_rx = rc == ERR_NONE;
    }
    if (rc == ERR_NONE)
        rc = s_rf.st25r200SetRegisterBits(ST25R200_REG_PROTOCOL_RX1,
                                         ST25R200_REG_PROTOCOL_RX1_antcl);
    uint8_t command = wupa ? 0x52 : 0x26;
    uint8_t rx[2] = {0};
    uint16_t bits = 0;
    rfalTransceiveContext ctx = {};
    ctx.txBuf = &command;
    ctx.txBufLen = 7;
    ctx.rxBuf = rx;
    ctx.rxBufLen = 16;
    ctx.rxRcvdLen = &bits;
    ctx.fwt = rfalConvMsTo1fc(5U);
    ctx.flags = RFAL_TXRX_FLAGS_CRC_TX_MANUAL | RFAL_TXRX_FLAGS_PAR_TX_NONE |
                RFAL_TXRX_FLAGS_CRC_RX_KEEP | RFAL_TXRX_FLAGS_CRC_RX_MANUAL;
    if (rc == ERR_NONE) rc = s_rf.rfalStartTransceive(&ctx);
    if (rc == ERR_NONE) {
        result[1] |= 1;  // Transceive accepted
        const uint32_t started = millis();
        do {
            s_rf.rfalWorker();
            // Entry into RX follows the driver's TX-end interrupt handling.
            if (s_rf.rfalIsTransceiveInRx()) result[1] |= 2;
            rc = s_rf.rfalGetTransceiveStatus();
            if (rc != ERR_BUSY) break;
            if ((uint32_t)(millis() - started) >= 80U) {
                result[1] |= 4;  // Software deadline, distinct from RF timeout
                rc = ERR_TIMEOUT;
                break;
            }
            delay(1);
        } while (true);
    }
    s_rf.rfalFieldOff();
    if (restore_rx) s_rf.st25r200WriteRegister(ST25R200_REG_PROTOCOL_RX1, rx_config);
    result[2] = (uint8_t)rc;
    result[3] = bits > 255 ? 255 : (uint8_t)bits;
    result[4] = rx[0];
    result[5] = rx[1];
    s_error = (uint8_t)rc;
    // Stay idle between host probes; normal NFC commands can restart wakeup.
}
uint8_t nfc_ic_id() { return s_ic_id; }
uint8_t nfc_last_error() { return s_error; }
uint8_t nfc_scan_stage() { return s_scan_stage; }
uint8_t nfc_scan_antenna() { return s_scan_antenna; }
bool nfc_irq_wakeup_enabled() { return s_wakeup_enabled; }
uint8_t nfc_wakeup_antenna() { return s_wakeup_antenna; }
uint16_t nfc_wakeup_irq_count() { return s_wakeup_irq_count; }

bool nfc_reg_read(uint8_t address, uint8_t *value) {
    if (!nfc_ensure_rfal() || !value || address > 0x3F) return false;
    stop_wakeup();
    s_rf.rfalFieldOff();
    const ReturnCode rc = s_rf.st25r200ReadRegister(address, value);
    s_error = (uint8_t)rc;
    return rc == ERR_NONE;
}

bool nfc_reg_write(uint8_t address, uint8_t value) {
    if (!nfc_ensure_rfal() || address > 0x3F) return false;
    stop_wakeup();
    s_rf.rfalFieldOff();
    const ReturnCode rc = s_rf.st25r200WriteRegister(address, value);
    s_error = (uint8_t)rc;
    return rc == ERR_NONE;
}

bool nfc_scan(uint8_t antenna, uint8_t *found_antenna, uint8_t *tag_type,
              uint8_t *uid, uint8_t *uid_len) {
    s_scan_stage = 0;
    // Default and "scan both" (0) drive silkscreen ANT1 (RFO2). Dual-scan
    // used to report Antenna 2 as the last failure even when the tag sat on ANT1.
    if (antenna != 2) antenna = 1;
    s_scan_antenna = antenna;
    if (!nfc_ensure_rfal()) return false;
    stop_wakeup();
    const bool ok = scan_one(antenna, tag_type, uid, uid_len, false);
    if (ok && found_antenna) *found_antenna = antenna;
    if (!ok) {
        s_tag_present = false;
        if (found_antenna) *found_antenna = antenna;
        if (tag_type) *tag_type = 0;
        if (uid_len) *uid_len = 0;
    }
    const uint8_t scan_error = s_error;
    // Do not restart LPCD here: WakeUpModeStart blocked TWAI (status 255).
    s_rf.rfalFieldOff();
    s_error = scan_error;
    return ok;
}

bool nfc_tag_read(uint8_t antenna, uint8_t page, uint8_t data[4]) {
    if (!nfc_ensure_rfal()) return false;
    stop_wakeup();
    uint8_t type = 0;
    uint8_t uid[10], uid_len = 0;
    if (!data || !scan_one(antenna, &type, uid, &uid_len, true) || type != 1) {
        s_rf.rfalFieldOff();
        return false;
    }
    uint8_t rx[16] = {0};
    uint16_t rx_len = 0;
    const ReturnCode rc = s_nfc.rfalT2TPollerRead(page, rx, sizeof(rx), &rx_len);
    s_rf.rfalFieldOff();
    s_error = (uint8_t)rc;
    if (rc != ERR_NONE || rx_len < 4) return false;
    memcpy(data, rx, 4);
    return true;
}

bool nfc_tag_write(uint8_t antenna, uint8_t page, const uint8_t data[4]) {
    if (!nfc_ensure_rfal()) return false;
    stop_wakeup();
    uint8_t type = 0;
    uint8_t uid[10], uid_len = 0;
    if (!data || !scan_one(antenna, &type, uid, &uid_len, true) || type != 1) {
        s_rf.rfalFieldOff();
        return false;
    }
    const ReturnCode rc = s_nfc.rfalT2TPollerWrite(page, data);
    s_rf.rfalFieldOff();
    s_error = (uint8_t)rc;
    return rc == ERR_NONE;
}

void nfc_tick(uint32_t now_ms) {
    (void)now_ms;
    if (!s_ready) {
        nfc_ensure_rfal();
        return;
    }
    if (!s_wakeup_enabled || !s_irq_pending) return;
    s_irq_pending = false;
    s_rf.rfalWorker();

    rfalWakeUpInfo info = {};
    if (s_rf.rfalWakeUpModeGetInfo(false, &info) != ERR_NONE) return;
    const bool load_changed = info.indAmp.irqWu || info.cap.irqWu;
    if (!load_changed && !info.irqWut) return;

    const uint8_t monitored = s_wakeup_antenna;
    stop_wakeup();
    if (load_changed) {
        uint8_t type = 0, uid_len = 0, uid[10] = {0};
        bool found = false;
        uint8_t found_ant = 0;
        for (uint8_t ant = 1; ant <= 2; ++ant) {
            if (scan_one(ant, &type, uid, &uid_len, false)) {
                found = true;
                found_ant = ant;
                break;
            }
        }
        if (!found) {
            s_tag_present = false;
            s_antenna = 0;
            s_tag_type = 0;
            s_uid_len = 0;
            // Absence/removal is a normal detector result, not an RFAL fault.
            s_error = 0;
        }
        start_wakeup(found ? found_ant : (monitored == 1 ? 2 : 1));
        return;
    }

    // With no tag, the timeout IRQ rotates the single wake-up detector over
    // ANT1 and ANT2. While a tag is present, stay on its antenna so its
    // removal creates the next load-change IRQ.
    start_wakeup(s_tag_present ? monitored : (monitored == 1 ? 2 : 1));
}

uint8_t nfc_detected_antenna(uint32_t now_ms) {
    (void)now_ms;
    return s_tag_present ? s_antenna : 0;
}
uint8_t nfc_cached_tag_type() { return s_tag_type; }
uint8_t nfc_cached_uid(uint8_t *uid, uint8_t cap) {
    const uint8_t n = s_uid_len < cap ? s_uid_len : cap;
    if (uid && n) memcpy(uid, s_uid, n);
    return n;
}
