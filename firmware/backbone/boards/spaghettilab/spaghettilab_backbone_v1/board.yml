## firmware/backbone/boards/spaghettilab/spaghettilab_backbone_v1/board.yml
```yaml
board:
  name: spaghettilab_backbone_v1
  full_name: Spaghetti LAB Backbone V1
  vendor: spaghettilab
  socs:
    - name: esp32s3
```

## firmware/backbone/boards/spaghettilab/spaghettilab_backbone_v2/Kconfig.spaghettilab_backbone_v2
```kconfig
config BOARD_SPAGHETTILAB_BACKBONE_V2
	select SOC_ESP32S3_MINI_N8
	select SOC_ESP32S3_PROCPU if BOARD_SPAGHETTILAB_BACKBONE_V2_ESP32S3_PROCPU
```

## firmware/backbone/boards/spaghettilab/spaghettilab_backbone_v2/board.yml
```yaml
board:
  name: spaghettilab_backbone_v2
  full_name: Spaghetti LAB Backbone V2
  vendor: spaghettilab
  socs:
    - name: esp32s3
```

## firmware/backbone/boards/spaghettilab/spaghettilab_core_v1/board.yml
```yaml
board:
  name: spaghettilab_core_v1
  full_name: Spaghetti LAB Core V1
  vendor: spaghettilab
  socs:
    - name: esp32c3
```

## firmware/backbone/boards/spaghettilab/spaghettilab_core_v2_build_only/board.yml
```yaml
board:
  name: spaghettilab_core_v2_build_only
  full_name: Spaghetti LAB Core V2 Build-Only
  vendor: spaghettilab
  socs:
    - name: esp32c3
```

## firmware/backbone/dts/bindings/spaghetti/spaghettilab,power-rail.yaml
```yaml
description: Spaghetti LAB power rail reaching Function Bays

compatible: "spaghettilab,power-rail"

include: base.yaml

properties:
  reg:
    required: true
    description: Stable logical rail identifier used by Config and admission

  assurance:
    type: string
    required: true
    description: How firmly firmware can select and verify this rail
    enum:
      - "unmanaged"
      - "switched"
      - "switched-and-measured"

  min-microvolts:
    type: int
    required: false
    default: 0
    description: Minimum supported voltage; zero means unknown

  max-microvolts:
    type: int
    required: false
    default: 0
    description: Maximum supported voltage; zero means unknown

  max-total-microamps:
    type: int
    required: false
    default: 0
    description: Maximum aggregate current; zero means unknown
```

## firmware/backbone/subsys/connectivity/Kconfig
```kconfig
module = SPAGHETTI_CONNECTIVITY
module-str = spaghetti_connectivity
source "subsys/logging/Kconfig.template.log_config"

choice SPAGHETTI_CONNECTIVITY_BOOT_POLICY
	prompt "Default connectivity policy"
	default SPAGHETTI_CONNECTIVITY_BOOT_ONLINE
	help
	  Select the policy passed by Core until Config persists this choice.

config SPAGHETTI_CONNECTIVITY_BOOT_LOW_ENERGY
	bool "Low energy"
	help
	  Keep Wi-Fi and MQTT outside the persistent service set.

config SPAGHETTI_CONNECTIVITY_BOOT_ONLINE
	bool "Online"
	help
	  Permit compiled Wi-Fi and MQTT. BLE stays outside this policy.

endchoice

config SPAGHETTI_CONNECTIVITY_MIN_LEASE_MS
	int "Minimum temporary connectivity lease in milliseconds"
	range 1 60000
	default 1000
	help
	  Reject accidental zero or impractically short connectivity windows.

config SPAGHETTI_CONNECTIVITY_MAX_LEASE_MS
	int "Maximum temporary connectivity lease in milliseconds"
	range SPAGHETTI_CONNECTIVITY_MIN_LEASE_MS 900000
	default 300000
	help
	  Upper bound for a temporary service lease. The Manager converts the
	  accepted duration to one absolute uptime deadline.
```

## firmware/backbone/subsys/core/Kconfig.health
```kconfig
# SPAGHETTI_HEALTH is compiled into every Core image.

module = SPAGHETTI_HEALTH
module-str = spaghetti_health
source "subsys/logging/Kconfig.template.log_config"

config SPAGHETTI_HEALTH_STACK_SIZE
	int "Health supervisor stack size"
	range 1024 4096
	default 1536
	help
	  Static stack bytes reserved for the single health supervisor thread.

config SPAGHETTI_HEALTH_PRIORITY
	int "Health supervisor thread priority"
	range 0 14
	default 3
	help
	  Preemptive priority used by the health supervisor. Lower numbers run
	  at higher priority; keep it above monitored workers.

config SPAGHETTI_HEALTH_POLL_MS
	int "Health supervisor poll period in milliseconds"
	range 10 5000
	default 250
	help
	  Interval between heartbeat deadline evaluations and optional WDT feeds.

config SPAGHETTI_HEALTH_WATCHDOG_MS
	int "Hardware watchdog timeout in milliseconds"
	range 100 60000
	default 5000
	help
	  Timeout installed when the board provides zephyr,watchdog. Ignored when
	  no chosen watchdog exists.

config SPAGHETTI_HEALTH_MAX_WINDOW_MS
	int "Maximum temporary health silence window in milliseconds"
	range 100 900000
	default 300000
	help
	  Upper bound accepted by spaghetti_health_window_acquire().

config SPAGHETTI_HEALTH_KEEPALIVE_MS
	int "Owner keepalive heartbeat period in milliseconds"
	range 10 60000
	default 1000
	help
	  Period used by registered owners that lack continuous work loops.
```

## firmware/backbone/subsys/feature_registry/Kconfig
```kconfig
module = SPAGHETTI_FEATURE_REGISTRY
module-str = spaghetti_feature_registry
source "subsys/logging/Kconfig.template.log_config"

config SPAGHETTI_PACK_CORE_BASIC
	bool
	default y
	help
	  Always-linked core Capability Pack (modules and threshold rule).

config SPAGHETTI_PACK_PROCESSING_BASIC
	bool "Include processing-basic Capability Pack"
	default y
	help
	  Declares the standard processing block types compiled into the image.

config SPAGHETTI_PACK_PROCESSING_KALMAN
	bool "Include processing-kalman Capability Pack"
	default y
	depends on SPAGHETTI_BLOCK_KALMAN
	depends on SPAGHETTI_PACK_PROCESSING_BASIC
	help
	  Declares the optional Kalman block when the block driver is compiled.

config SPAGHETTI_PACK_DEVICE_PROFILE
	bool "Include device-profile-engine Capability Pack"
	default y
	help
	  Declares the declarative-device Module type and profile engine surface.

config SPAGHETTI_PACK_MODBUS
	bool "Include stub transport-modbus Capability Pack"
	default n
	help
	  Links an empty Modbus transport pack descriptor for differential builds
	  and catalog tests. No Modbus runtime is compiled yet.

config SPAGHETTI_FLASH_SLOT_BYTES
	int "Declared primary image-slot size in bytes"
	range 65536 4194304
	default 1048576
	help
	  Build-time flash slot budget published by the image manifest.

config SPAGHETTI_FLASH_IMAGE_BUDGET_BYTES
	int "Declared maximum application image size in bytes"
	range 32768 4194304
	default 917504
	help
	  Build gate and manifest budget for the signed application image.

config SPAGHETTI_FLASH_HEADROOM_BYTES
	int "Declared flash headroom reserved for headers/trailers"
	range 0 1048576
	default 65536

config SPAGHETTI_STATIC_RAM_BUDGET_BYTES
	int "Declared static RAM budget in bytes"
	range 32768 1048576
	default 327680

config SPAGHETTI_DECLARED_STACK_BYTES
	int "Declared aggregate stack reservation in bytes"
	range 4096 262144
	default 24576

config SPAGHETTI_DECLARED_POOL_BYTES
	int "Declared aggregate pool reservation in bytes"
	range 4096 524288
	default 65536

config SPAGHETTI_DECLARED_WORKSPACE_BYTES
	int "Declared workspace reservation in bytes"
	range 4096 262144
	default 60000
	help
	  Declared workspace budget published by the image manifest. Matches the
	  secure-workspace profile budget when that service is compiled.
```

## firmware/backbone/subsys/power/Kconfig
```kconfig
menuconfig SPAGHETTI_ENERGY
	bool "Spaghetti LAB low-energy policy orchestrator"
	default y
	help
	  Apply LOW_ENERGY and ONLINE connectivity effects on the fake BLE
	  radio state machine, optional runtime PM, and software metrics.

if SPAGHETTI_ENERGY

config SPAGHETTI_ENERGY_MIN_ADVERTISING_WINDOW_MS
	int "Minimum BLE advertising window in milliseconds"
	range 10 60000
	default 1000
	help
	  Lower bound accepted by spaghetti_energy_init() for windowed BLE.

config SPAGHETTI_ENERGY_MAX_ADVERTISING_WINDOW_MS
	int "Maximum BLE advertising window in milliseconds"
	range SPAGHETTI_ENERGY_MIN_ADVERTISING_WINDOW_MS 600000
	default 60000
	help
	  Upper bound accepted by spaghetti_energy_init() for windowed BLE.

config SPAGHETTI_ENERGY_MIN_ADVERTISING_PERIOD_MS
	int "Minimum BLE advertising period in milliseconds"
	range 50 3600000
	default 60000
	help
	  Lower bound accepted by spaghetti_energy_init() for windowed BLE.

config SPAGHETTI_ENERGY_MAX_ADVERTISING_PERIOD_MS
	int "Maximum BLE advertising period in milliseconds"
	range SPAGHETTI_ENERGY_MIN_ADVERTISING_PERIOD_MS 3600000
	default 3600000
	help
	  Upper bound accepted by spaghetti_energy_init() for windowed BLE.

module = SPAGHETTI_ENERGY
module-str = spaghetti_energy
source "subsys/logging/Kconfig.template.log_config"

endif # SPAGHETTI_ENERGY
```

## firmware/backbone/subsys/resources/Kconfig
```kconfig
module = SPAGHETTI_RESOURCES
module-str = spaghetti_resources
source "subsys/logging/Kconfig.template.log_config"

config SPAGHETTI_RESOURCES_STACK_STATS
	bool "Collect optional stack high-water metrics"
	default n
	help
	  Enable only when stack analyzer support is intentionally selected.
	  Production profiles keep this disabled to avoid expensive stats.
```

## firmware/backbone/subsys/services/secure_workspace/Kconfig
```kconfig
module = SPAGHETTI_SECURE_WORKSPACE
module-str = spaghetti_secure_workspace
source "subsys/logging/Kconfig.template.log_config"

config SPAGHETTI_SECURE_WORKSPACE_ACQUIRE_MAX_MS
	int "Maximum secure-workspace admission wait in milliseconds"
	range 1 30000
	default 5000
	help
	  Upper bound accepted by the workspace API. K_FOREVER is never allowed.

config SPAGHETTI_SECURE_WORKSPACE_OTA_WAIT_MS
	int "OTA secure-workspace wait in milliseconds"
	range 1 SPAGHETTI_SECURE_WORKSPACE_ACQUIRE_MAX_MS
	default 5000
	help
	  Maximum time Wi-Fi OTA waits for MQTT or another secure owner to stop.

config SPAGHETTI_SECURE_WORKSPACE
	bool
	default y
	select SYS_HEAP_RUNTIME_STATS
	depends on COMMON_LIBC_MALLOC
	help
	  Enable deterministic admission and common-libc heap high-water metrics.
```

## firmware/backbone/templates/firmware/Kconfig.template
```kconfig
# SPDX-License-Identifier: <PROJECT-LICENSE-ID>

menuconfig SPAGHETTI_EXAMPLE
	bool "Spaghetti LAB Example component"
	help
	  Enable the Example component. Replace this text with the owned
	  responsibility and relevant dependency information.

if SPAGHETTI_EXAMPLE

config SPAGHETTI_EXAMPLE_WORKER
	bool "Use a dedicated Example worker"
	default n
	help
	  Enable only when the component owns a blocking state machine or ordered
	  work that must not use the system workqueue.

config SPAGHETTI_EXAMPLE_STACK_SIZE
	int "Example worker stack size"
	depends on SPAGHETTI_EXAMPLE_WORKER
	default 1024
	range 512 8192
	help
	  Worker stack size in bytes. Confirm the default using Zephyr stack usage
	  measurements on every supported architecture.

config SPAGHETTI_EXAMPLE_THREAD_PRIORITY
	int "Example worker preemptive priority"
	depends on SPAGHETTI_EXAMPLE_WORKER
	default 5
	help
	  Zephyr preemptive thread priority. Lower numbers have higher priority.
	  Compare this value with all threads involved in the same data path.

config SPAGHETTI_EXAMPLE_QUEUE_DEPTH
	int "Example command queue depth"
	depends on SPAGHETTI_EXAMPLE_WORKER
	default 4
	range 1 32
	help
	  Maximum number of copied commands waiting for the worker. The API must
	  define behavior when the queue is full.

module = SPAGHETTI_EXAMPLE
module-str = spaghetti_example
source "subsys/logging/Kconfig.template.log_config"

endif # SPAGHETTI_EXAMPLE
```

## firmware/backbone/tests/access_control/Kconfig
```kconfig
mainmenu "Spaghetti access-control tests"

rsource "../../Kconfig.resources"

config SPAGHETTI_ACCESS_CONTROL_LOG_LEVEL
	int
	default 0

source "Kconfig.zephyr"
```

## firmware/backbone/tests/access_control/testcase.yaml
```yaml
tests:
  spaghetti.access_control:
    platform_allow:
      - native_sim/native/64
    tags:
      - spaghetti
      - access_control
```

## firmware/backbone/tests/ble_protocol/testcase.yaml
```yaml
tests:
  spaghetti.ble_protocol:
    platform_allow:
      - native_sim/native/64
    tags:
      - spaghetti
      - ble
      - communication
```

## firmware/backbone/tests/ble_wifi_handover/testcase.yaml
```yaml
tests:
  spaghetti.ble_wifi_handover:
    platform_allow:
      - native_sim/native/64
    tags:
      - spaghetti
      - ble
      - connectivity
```

## firmware/backbone/tests/capabilities/Kconfig
```kconfig
mainmenu "Spaghetti Capabilities tests"

rsource "../../Kconfig.resources"

source "Kconfig.zephyr"
```

## firmware/backbone/tests/capabilities/testcase.yaml
```yaml
tests:
  spaghetti.capabilities.minimal:
    platform_allow:
      - native_sim/native/64
    extra_configs:
      - CONFIG_SPAGHETTI_RESOURCE_PROFILE_MINIMAL=y
    tags:
      - spaghetti
      - capabilities
  spaghetti.capabilities.standard:
    platform_allow:
      - native_sim/native/64
    extra_configs:
      - CONFIG_SPAGHETTI_RESOURCE_PROFILE_STANDARD=y
    tags:
      - spaghetti
      - capabilities
  spaghetti.capabilities.extended:
    platform_allow:
      - native_sim/native/64
    extra_configs:
      - CONFIG_SPAGHETTI_RESOURCE_PROFILE_EXTENDED=y
    tags:
      - spaghetti
      - capabilities
```

## firmware/backbone/tests/config/testcase.yaml
```yaml
tests:
  spaghetti.config:
    platform_allow:
      - native_sim/native/64
    tags:
      - spaghetti
      - config
```

## firmware/backbone/tests/config_codec/testcase.yaml
```yaml
tests:
  spaghetti.config_codec:
    platform_allow:
      - native_sim/native/64
    tags:
      - spaghetti
      - config
      - cbor
```

## firmware/backbone/tests/connectivity/testcase.yaml
```yaml
tests:
  spaghetti.connectivity:
    platform_allow:
      - native_sim/native/64
    tags:
      - spaghetti
      - connectivity
```
