## firmware/backbone/tests/power/testcase.yaml
```yaml
tests:
  spaghetti.power:
    platform_allow:
      - native_sim/native/64
    tags:
      - spaghetti
      - power
```

## firmware/backbone/tests/processing/testcase.yaml
```yaml
tests:
  spaghetti.processing:
    platform_allow:
      - native_sim/native/64
    tags:
      - spaghetti
      - processing
```

## firmware/backbone/tests/protocol/Kconfig
```kconfig
mainmenu "Spaghetti Protocol V1 tests"

rsource "../../Kconfig.resources"
rsource "../../subsys/core/Kconfig.health"

config SPAGHETTI_MAX_MODULES
	int
	default 8

config SPAGHETTI_COMMUNICATION_LOG_LEVEL
	int
	default 0

config SPAGHETTI_WIFI_PROFILE_MAX_COUNT
	int
	default 4

config SPAGHETTI_WIFI_PASSWORD_INPUT_TIMEOUT_SECONDS
	int
	default 60

config SPAGHETTI_REMOTE_CONSOLE_CREDENTIAL_INPUT_TIMEOUT_SECONDS
	int
	default 60

config SPAGHETTI_MAINTENANCE_REBOOT_DELAY_MS
	int
	default 10

source "Kconfig.zephyr"
```

## firmware/backbone/tests/protocol/testcase.yaml
```yaml
tests:
  spaghetti.protocol:
    platform_allow:
      - native_sim/native/64
    tags:
      - spaghetti
```

## firmware/backbone/tests/record_delivery/testcase.yaml
```yaml
tests:
  spaghetti.record_delivery:
    platform_allow:
      - native_sim/native/64
    tags:
      - spaghetti
      - record_delivery
  spaghetti.record_delivery.capacity_one:
    platform_allow:
      - native_sim/native/64
    tags:
      - spaghetti
      - record_delivery
    extra_configs:
      - CONFIG_SPAGHETTI_MAX_RECORD_QUEUE=1
```

## firmware/backbone/tests/relay/Kconfig
```kconfig
mainmenu "Spaghetti Relay tests"

rsource "../../Kconfig.resources"

config SPAGHETTI_RELAY_LOG_LEVEL
	int
	default 0

config SPAGHETTI_RELAY_MAX_INSTANCES
	int
	default 2

config SPAGHETTI_SCHEMA_LOG_LEVEL
	int
	default 0

source "Kconfig.zephyr"
```

## firmware/backbone/tests/remote_console/Kconfig
```kconfig
mainmenu "Spaghetti Remote Console tests"

rsource "../../Kconfig.resources"

config SPAGHETTI_REMOTE_CONSOLE_LOG_LEVEL
	int
	default 0

config SPAGHETTI_REMOTE_CONSOLE_PORT
	int
	default 1338

config SPAGHETTI_SERVICE_STOP_MAX_MS
	int
	default 100

source "Kconfig.zephyr"
```

## firmware/backbone/tests/remote_console/testcase.yaml
```yaml
tests:
  spaghetti.remote_console.policy:
    platform_allow:
      - native_sim/native/64
    tags:
      - spaghetti
      - remote_console
      - communication
```

## firmware/backbone/tests/resources/testcase.yaml
```yaml
tests:
  spaghetti.resources.snapshot:
    platform_allow:
      - native_sim/native/64
    tags:
      - spaghetti
      - resources
```

## firmware/backbone/tests/rule_registry/Kconfig
```kconfig
mainmenu "Spaghetti Rule Registry tests"

rsource "../../Kconfig.resources"

config SPAGHETTI_RULE_REGISTRY_LOG_LEVEL
	int
	default 0

config SPAGHETTI_SCHEMA_LOG_LEVEL
	int
	default 0

source "Kconfig.zephyr"
```

## firmware/backbone/tests/rule_registry/testcase.yaml
```yaml
tests:
  spaghetti.rule_registry:
    platform_allow:
      - native_sim/native/64
    tags:
      - spaghetti
      - rule_registry
```

## firmware/backbone/tests/schema/Kconfig
```kconfig
mainmenu "Spaghetti Schema tests"

rsource "../../Kconfig.resources"

config SPAGHETTI_SCHEMA_LOG_LEVEL
	int
	default 3

source "Kconfig.zephyr"
```

## firmware/backbone/tests/schema/testcase.yaml
```yaml
tests:
  spaghetti.schema:
    platform_allow:
      - native_sim/native/64
    tags:
      - spaghetti
      - schema
```

## firmware/backbone/tests/secure_workspace/testcase.yaml
```yaml
tests:
  spaghetti.secure_workspace:
    platform_allow:
      - native_sim/native/64
    tags:
      - spaghetti
      - secure_workspace
      - tls
```

## firmware/backbone/tests/service_manager/testcase.yaml
```yaml
tests:
  spaghetti.service_manager:
    platform_allow:
      - native_sim/native/64
    tags:
      - spaghetti
      - service_manager
      - lifecycle
```

## firmware/backbone/tests/storage/testcase.yaml
```yaml
tests:
  spaghetti.storage:
    platform_allow:
      - native_sim/native/64
    tags:
      - spaghetti
      - storage
```

## firmware/backbone/tests/templates/testcase.yaml
```yaml
tests:
  spaghetti.templates:
    platform_allow:
      - native_sim/native/64
    tags:
      - spaghetti
      - templates
      - module_driver
      - device_profile
      - block_driver
      - feature_pack
      - topology
```

## firmware/backbone/tests/threshold/Kconfig
```kconfig
mainmenu "Spaghetti Threshold tests"

rsource "../../Kconfig.resources"

config SPAGHETTI_THRESHOLD_LOG_LEVEL
	int
	default 0

config SPAGHETTI_THRESHOLD_MAX_INSTANCES
	int
	default 4

config SPAGHETTI_SCHEMA_LOG_LEVEL
	int
	default 0

source "Kconfig.zephyr"
```

## firmware/backbone/tests/threshold/testcase.yaml
```yaml
tests:
  spaghetti.threshold:
    platform_allow:
      - native_sim/native/64
    tags:
      - spaghetti
      - threshold
      - rules
```

## firmware/backbone/tests/topology/testcase.yaml
```yaml
tests:
  spaghetti.topology:
    platform_allow:
      - native_sim/native/64
    tags:
      - spaghetti
      - topology
```

## firmware/backbone/tests/update/Kconfig
```kconfig
mainmenu "Spaghetti Update tests"

rsource "../../Kconfig.resources"

config SPAGHETTI_UPDATE_LOG_LEVEL
	int
	default 0

config SPAGHETTI_UPDATE_WORK_STACK_SIZE
	int
	default 1024

config SPAGHETTI_UPDATE_WORK_PRIORITY
	int
	default 5

config SPAGHETTI_UPDATE_TEST_TRIAL
	bool "Start the fake backend in trial boot"
	default n

config SPAGHETTI_HEALTH_KEEPALIVE_MS
	int
	default 50

config SPAGHETTI_HEALTH_MAX_WINDOW_MS
	int
	default 200

source "Kconfig.zephyr"
```

## firmware/backbone/tests/update/testcase.yaml
```yaml
tests:
  spaghetti.update:
    platform_allow:
      - native_sim/native/64
    tags:
      - spaghetti
      - update
  spaghetti.update.trial:
    platform_allow:
      - native_sim/native/64
    extra_configs:
      - CONFIG_SPAGHETTI_UPDATE_TEST_TRIAL=y
    tags:
      - spaghetti
      - update
```

## firmware/backbone/tests/usb_protocol/Kconfig
```kconfig
mainmenu "Spaghetti USB Protocol framing tests"

rsource "../../Kconfig.resources"

config SPAGHETTI_COMMUNICATION_LOG_LEVEL
	int
	default 0

source "Kconfig.zephyr"
```

## firmware/backbone/tests/usb_protocol/testcase.yaml
```yaml
tests:
  spaghetti.usb_protocol:
    platform_allow:
      - native_sim/native/64
    tags:
      - spaghetti
      - protocol
      - usb
```

## firmware/backbone/tests/v1_extension/testcase.yaml
```yaml
tests:
  spaghetti.v1_extension:
    platform_allow:
      - native_sim/native/64
    tags:
      - spaghetti
      - v1
      - extension
      - module_driver
      - rule_driver
      - block_driver
      - device_profile
      - discovery
      - topology
      - power
```
