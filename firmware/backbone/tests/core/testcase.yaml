## firmware/backbone/tests/core/testcase.yaml
```yaml
tests:
  spaghetti.core:
    platform_allow:
      - native_sim/native/64
    tags:
      - spaghetti
      - core
      - engine
  spaghetti.core.unprovisioned:
    platform_allow:
      - native_sim/native/64
    extra_configs:
      - CONFIG_SPAGHETTI_TEST_CONFIG_ABSENT=y
    tags:
      - spaghetti
      - core
  spaghetti.core.marker:
    platform_allow:
      - native_sim/native/64
    extra_configs:
      - CONFIG_SPAGHETTI_TEST_MAINTENANCE_MARKER=y
    tags:
      - spaghetti
      - core
  spaghetti.core.bootstrap:
    platform_allow:
      - native_sim/native/64
    extra_configs:
      - CONFIG_SPAGHETTI_TEST_BOOTSTRAP_REQUEST=y
    tags:
      - spaghetti
      - core
  spaghetti.core.trial:
    platform_allow:
      - native_sim/native/64
    extra_configs:
      - CONFIG_SPAGHETTI_TEST_TRIAL_IMAGE=y
    tags:
      - spaghetti
      - core
```

## firmware/backbone/tests/device_profiles/testcase.yaml
```yaml
tests:
  spaghetti.device_profiles:
    platform_allow:
      - native_sim/native/64
    tags:
      - spaghetti
      - device_profiles
```

## firmware/backbone/tests/discovery/testcase.yaml
```yaml
tests:
  spaghetti.discovery:
    platform_allow:
      - native_sim/native/64
    tags:
      - spaghetti
      - discovery
```

## firmware/backbone/tests/discovery_providers/Kconfig
```kconfig
mainmenu "Spaghetti Discovery provider tests"

rsource "../../Kconfig.resources"

config SPAGHETTI_MAX_MODULES
	int
	default 8

config SPAGHETTI_DISCOVERY_MAX_RESULTS
	int
	default 8

config SPAGHETTI_DISCOVERY_LOG_LEVEL
	int
	default 0

source "Kconfig.zephyr"
```

## firmware/backbone/tests/discovery_providers/testcase.yaml
```yaml
tests:
  spaghetti.discovery_providers:
    platform_allow:
      - native_sim/native/64
    tags:
      - spaghetti
      - discovery
```

## firmware/backbone/tests/driver_registry/Kconfig
```kconfig
mainmenu "Spaghetti Driver Registry tests"

rsource "../../Kconfig.resources"

config SPAGHETTI_DRIVER_REGISTRY_LOG_LEVEL
	int
	default 0

config SPAGHETTI_SCHEMA_LOG_LEVEL
	int
	default 0

source "Kconfig.zephyr"
```

## firmware/backbone/tests/driver_registry/testcase.yaml
```yaml
tests:
  spaghetti.driver_registry:
    platform_allow:
      - native_sim/native/64
    tags:
      - spaghetti
      - driver_registry
      - module_driver
```

## firmware/backbone/tests/energy/testcase.yaml
```yaml
tests:
  spaghetti.energy:
    platform_allow:
      - native_sim/native/64
    tags:
      - spaghetti
      - energy
```

## firmware/backbone/tests/enrollment/testcase.yaml
```yaml
tests:
  spaghettilab.enrollment.community_fallback:
    platform_allow:
      - native_sim/native/64
    tags:
      - enrollment
      - identity
```

## firmware/backbone/tests/factory_reset/Kconfig
```kconfig
mainmenu "Spaghetti factory-reset tests"

rsource "../../Kconfig.resources"

config SPAGHETTI_FACTORY_RESET_LOG_LEVEL
	int
	default 0

config SPAGHETTI_ACCESS_CONTROL_LOG_LEVEL
	int
	default 0

config SPAGHETTI_SERVICE_STOP_MAX_MS
	int
	default 100

config SPAGHETTI_SERVICE_ID_MAX_SIZE
	int
	default 24

source "Kconfig.zephyr"
```

## firmware/backbone/tests/factory_reset/testcase.yaml
```yaml
tests:
  spaghetti.factory_reset:
    platform_allow:
      - native_sim/native/64
    tags:
      - spaghetti
      - factory_reset
```

## firmware/backbone/tests/feature_packs/testcase.yaml
```yaml
tests:
  spaghetti.feature_packs.base:
    platform_allow:
      - native_sim/native/64
    tags:
      - spaghetti
      - feature_packs
  spaghetti.feature_packs.kalman:
    platform_allow:
      - native_sim/native/64
    extra_configs:
      - CONFIG_SPAGHETTI_BLOCK_KALMAN=y
      - CONFIG_SPAGHETTI_PACK_PROCESSING_KALMAN=y
    tags:
      - spaghetti
      - feature_packs
  spaghetti.feature_packs.modbus:
    platform_allow:
      - native_sim/native/64
    extra_configs:
      - CONFIG_SPAGHETTI_PACK_MODBUS=y
    tags:
      - spaghetti
      - feature_packs
  spaghetti.feature_packs.kalman_modbus:
    platform_allow:
      - native_sim/native/64
    extra_configs:
      - CONFIG_SPAGHETTI_BLOCK_KALMAN=y
      - CONFIG_SPAGHETTI_PACK_PROCESSING_KALMAN=y
      - CONFIG_SPAGHETTI_PACK_MODBUS=y
    tags:
      - spaghetti
      - feature_packs
```

## firmware/backbone/tests/field_update/testcase.yaml
```yaml
tests:
  spaghetti.field_update:
    platform_allow:
      - native_sim/native/64
    tags:
      - spaghetti
      - update
      - field_update
```

## firmware/backbone/tests/fuzz/testcase.yaml
```yaml
tests:
  spaghetti.fuzz:
    platform_allow:
      - native_sim/native/64
    tags:
      - spaghetti
      - fuzz
      - protocol
      - v1
```

## firmware/backbone/tests/identity/Kconfig
```kconfig
mainmenu "Spaghetti identity tests"

rsource "../../Kconfig.resources"

config SPAGHETTI_IDENTITY_LOG_LEVEL
	int
	default 0

source "Kconfig.zephyr"
```

## firmware/backbone/tests/identity/testcase.yaml
```yaml
tests:
  spaghetti.identity:
    platform_allow:
      - native_sim/native/64
    tags:
      - spaghetti
      - identity
```

## firmware/backbone/tests/ina219_runtime/testcase.yaml
```yaml
tests:
  spaghetti.ina219_runtime:
    platform_allow:
      - native_sim/native/64
    tags:
      - spaghetti
      - ina219
      - module_manager
```

## firmware/backbone/tests/module_manager/testcase.yaml
```yaml
tests:
  spaghetti.module_manager:
    platform_allow:
      - native_sim/native/64
    tags:
      - spaghetti
      - module_manager
```

## firmware/backbone/tests/ota/Kconfig
```kconfig
mainmenu "Spaghetti OTA tests"

rsource "../../Kconfig.resources"

config SPAGHETTI_OTA_LOG_LEVEL
	int
	default 0

config SPAGHETTI_OTA_PORT
	int
	default 1337

config SPAGHETTI_OTA_MAX_WINDOW_MS
	int
	default 100

config SPAGHETTI_OTA_WORK_STACK_SIZE
	int
	default 1024

config SPAGHETTI_OTA_WORK_PRIORITY
	int
	default 5

config SPAGHETTI_MAINTENANCE_REBOOT_DELAY_MS
	int
	default 10

config SPAGHETTI_SECURE_WORKSPACE_OTA_WAIT_MS
	int
	default 20

config SPAGHETTI_SERVICE_STOP_MAX_MS
	int
	default 100

source "Kconfig.zephyr"
```

## firmware/backbone/tests/ota/testcase.yaml
```yaml
tests:
  spaghetti.ota.policy:
    platform_allow:
      - native_sim/native/64
    tags:
      - spaghetti
      - ota
      - update
```

## firmware/backbone/tests/ota_ble/Kconfig
```kconfig
mainmenu "Spaghetti BLE OTA tests"

rsource "../../Kconfig.resources"

config SPAGHETTI_OTA_LOG_LEVEL
	int
	default 0

config SPAGHETTI_OTA_BLE_RESUME_MS
	int
	default 40

config SPAGHETTI_OTA_BLE_WINDOW_MS
	int
	default 1000

config SPAGHETTI_RUNTIME_STOP_TIMEOUT_MS
	int
	default 20

config SPAGHETTI_SERVICE_STOP_MAX_MS
	int
	default 100

source "Kconfig.zephyr"
```

## firmware/backbone/tests/ota_ble/testcase.yaml
```yaml
tests:
  spaghetti.ota_ble:
    platform_allow:
      - native_sim/native/64
    tags:
      - spaghetti
      - ota
      - update
      - ble
```

## firmware/backbone/tests/physical/testcase.yaml
```yaml
tests:
  spaghetti.physical:
    platform_allow:
      - native_sim/native/64
    tags:
      - spaghetti
      - topology
      - nfc
```

## firmware/backbone/tests/port_transport/testcase.yaml
```yaml
tests:
  spaghetti.port_transport:
    platform_allow:
      - native_sim/native/64
    tags:
      - spaghetti
      - port
```

## firmware/backbone/tests/power/Kconfig
```kconfig
mainmenu "Spaghetti Power tests"

rsource "../../Kconfig.resources"

config SPAGHETTI_POWER
	bool
	default y

config SPAGHETTI_POWER_FAKE_BACKEND
	bool
	default y

config SPAGHETTI_POWER_LOG_LEVEL
	int
	default 0

config SPAGHETTI_TOPOLOGY_LOG_LEVEL
	int
	default 0

source "Kconfig.zephyr"
```
