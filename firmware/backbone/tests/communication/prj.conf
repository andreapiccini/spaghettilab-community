## CMakeLists.txt
```
cmake_minimum_required(VERSION 3.20.0)

find_package(Zephyr REQUIRED HINTS $ENV{ZEPHYR_BASE})
project(spaghetti_communication_test)

target_sources(app PRIVATE
  src/main.c
  ../../subsys/communication/communication.c
  ../../subsys/communication/protocol_cbor.c
  ../../subsys/communication/protocol_status.c
  ../../subsys/communication/ops_helpers.c
  ../../subsys/communication/communication_shell.c
  ../../subsys/communication/usb_protocol_framing.c
  ../../subsys/communication/usb_protocol.c
  ../../subsys/communication/operations/catalog.c
  ../../subsys/communication/operations/status.c
  ../../subsys/topology/physical.c
  ../../subsys/communication/operations/physical_ops.c
  src/nfc_fake.c
  ../../subsys/communication/operations/config_ops.c
  ../../subsys/communication/operations/discovery_ops.c
  ../../subsys/communication/operations/module_command.c
  ../../subsys/communication/operations/update_ops.c
  ../../subsys/communication/operations/capabilities_ops.c
  ../../subsys/communication/operations/connectivity_ops.c
  ../../subsys/communication/operations/reset_ops.c
  ../../subsys/communication/operations/audit_ops.c
  ../../subsys/communication/operations/job_ops.c
  ../../subsys/communication/operations/topology_ops.c
  ../../subsys/communication/operations/resources_ops.c
  ../../subsys/communication/operations/features_ops.c
  ../../subsys/communication/operations/device_profile_ops.c
)

zephyr_linker_sources(SECTIONS ../../subsys/communication/operation_sections.ld)

target_include_directories(app PRIVATE
  ../../include
  ../../subsys/communication
)
```

## Kconfig
```
mainmenu "Spaghetti Communication tests"

rsource "../../Kconfig.resources"
rsource "../../subsys/core/Kconfig.health"

config SPAGHETTI_MAX_MODULES
	int
	default 8

config SPAGHETTI_COMMUNICATION_LOG_LEVEL
	int
	default 0

config SPAGHETTI_WIFI_PROFILE_MAX_COUNT
	int
	default 4

config SPAGHETTI_WIFI_PASSWORD_INPUT_TIMEOUT_SECONDS
	int
	default 60

config SPAGHETTI_REMOTE_CONSOLE_CREDENTIAL_INPUT_TIMEOUT_SECONDS
	int
	default 60

config SPAGHETTI_MAINTENANCE_REBOOT_DELAY_MS
	int
	default 10

source "Kconfig.zephyr"
```

## prj.conf
```kconfig
CONFIG_ZTEST=y
CONFIG_ZCBOR=y
CONFIG_LOG=y
CONFIG_SHELL=y
CONFIG_THREAD_NAME=y
CONFIG_HEAP_MEM_POOL_SIZE=65536

CONFIG_SPAGHETTI_MAX_DEVICE_PROFILE_BYTES=4096
```

## src/nfc_fake.c
```c
/* Mutable NFC presence fixture for the real GET_STATUS operation encoder. */
#include <spaghetti/nfc.h>
#include <errno.h>
#include <string.h>

bool test_nfc_present;

int spaghetti_nfc_copy_tags(struct spaghetti_nfc_tag *out, size_t max, size_t *count)
{
	if (count == NULL || (out == NULL && max != 0U)) return -EINVAL;
	*count = test_nfc_present ? 1U : 0U;
	if (out != NULL && max > 0U && test_nfc_present) {
		const struct spaghetti_nfc_tag blank = {
			.antenna = 1U,
			.type = SPAGHETTI_NFC_TYPE_T2T,
			.uid_len = 7U,
			.uid = {2U, 1U, 2U, 3U, 4U, 5U, 6U},
			.node_id = 0xe18030U,
			.local = false,
			.module_type_id = 0U,
		};

		*out = blank;
	}
	return 0;
}

const char *spaghetti_nfc_type_id(const struct spaghetti_nfc_tag *tag)
{
	(void)tag;
	return "t2t";
}

int spaghetti_nfc_init(void) { return 0; }
int spaghetti_nfc_user_page(uint8_t antenna, const uint8_t uid[7], uint8_t page,
                           uint8_t data[4], bool write)
{
 (void)antenna; (void)uid; (void)page; (void)data; (void)write;
 return -ENOTSUP;
}
```
