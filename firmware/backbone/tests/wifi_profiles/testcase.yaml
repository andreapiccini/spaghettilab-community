## firmware/backbone/tests/wifi_profiles/testcase.yaml
```yaml
tests:
  spaghetti.wifi_profiles:
    platform_allow:
      - native_sim/native/64
    tags:
      - spaghetti
      - wifi
      - storage
  spaghetti.wifi_profiles.offline:
    platform_allow:
      - native_sim/native/64
    extra_configs:
      - CONFIG_SPAGHETTI_WIFI_PROFILES_TEST_OFFLINE=y
    tags:
      - spaghetti
      - wifi
      - maintenance
```
